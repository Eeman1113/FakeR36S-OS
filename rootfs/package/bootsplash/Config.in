## rootfs/package/bootsplash/Config.in
```kconfig
config BR2_PACKAGE_BOOTSPLASH
	bool "bootsplash"
	depends on BR2_INSTALL_LIBSTDCPP
	select BR2_PACKAGE_SDL2
	select BR2_PACKAGE_IMGUI
	help
	  FakeR36S-OS animated boot splash with chime.
```

## rootfs/package/dashboard/Config.in
```kconfig
config BR2_PACKAGE_DASHBOARD
	bool "dashboard"
	depends on BR2_INSTALL_LIBSTDCPP
	select BR2_PACKAGE_SDL2
	select BR2_PACKAGE_IMGUI
	help
	  FakeR36S-OS system dashboard: live CPU, battery, memory,
	  storage and temperature stats with graphs.
```

## rootfs/package/emulationstation-fcamod/Config.in
```kconfig
config BR2_PACKAGE_EMULATIONSTATION_FCAMOD
	bool "emulationstation-fcamod"
	depends on BR2_INSTALL_LIBSTDCPP
	depends on BR2_PACKAGE_MESA3D_OPENGL_ES
	select BR2_PACKAGE_SDL2
	select BR2_PACKAGE_SDL2_MIXER
	select BR2_PACKAGE_FREETYPE
	select BR2_PACKAGE_LIBFREEIMAGE
	select BR2_PACKAGE_LIBCURL
	select BR2_PACKAGE_VLC
	select BR2_PACKAGE_RAPIDJSON
	select BR2_PACKAGE_ALSA_LIB
	select BR2_PACKAGE_LIBDRM
	help
	  EmulationStation fcamod (christianhaitian), the ArkOS frontend.
```

## rootfs/package/es-theme-carbon/Config.in
```kconfig
config BR2_PACKAGE_ES_THEME_CARBON
	bool "es-theme-carbon"
	help
	  Carbon theme for EmulationStation.
```

## rootfs/package/es-theme-epic-cody/Config.in
```kconfig
config BR2_PACKAGE_ES_THEME_EPIC_CODY
	bool "es-theme-epic-cody"
	help
	  EPIC-CODY EmulationStation theme by CodyV59 (EpicNoir fork),
	  640x480 RG351V edition. CC BY-NC-SA 4.0.
	  https://github.com/CodyV59/es-theme-epic-cody-RG351V
```

## rootfs/package/koreader/Config.in
```kconfig
config BR2_PACKAGE_KOREADER
	bool "koreader"
	depends on BR2_PACKAGE_SDL3
	help
	  KOReader, the ebook reader (EPUB, PDF, MOBI, CBZ, DjVu...), from its official
	  32-bit ARM Linux release, drawing through the system SDL3 (KMS/DRM).
	  https://github.com/koreader/koreader
```

## rootfs/package/parallel-n64/Config.in
```kconfig
config BR2_PACKAGE_PARALLEL_N64
	bool "parallel-n64"
	depends on BR2_PACKAGE_MESA3D_OPENGL_ES
	help
	  ParaLLEl N64 libretro core, built for the GA36's Cortex-A7
	  (classic_armv7_a7: NEON, GLES2, ARM dynarec).
```

## rootfs/package/power-menu/Config.in
```kconfig
config BR2_PACKAGE_POWER_MENU
	bool "power-menu"
	depends on BR2_INSTALL_LIBSTDCPP
	select BR2_PACKAGE_SDL2
	select BR2_PACKAGE_IMGUI
	help
	  FakeR36S-OS power menu, shown when the power button is held.

comment "power-menu needs a toolchain w/ C++"
	depends on !BR2_INSTALL_LIBSTDCPP
```
